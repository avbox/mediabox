## sdk/external/Config.in
```kconfig
source "$BR2_EXTERNAL_MEDIABOX_PATH/package/mediabox/Config.in"
source "$BR2_EXTERNAL_MEDIABOX_PATH/package/nspr/Config.in"
source "$BR2_EXTERNAL_MEDIABOX_PATH/package/spidermonkey/Config.in"
source "$BR2_EXTERNAL_MEDIABOX_PATH/package/mediatomb/Config.in"
source "$BR2_EXTERNAL_MEDIABOX_PATH/package/avmount/Config.in"
source "$BR2_EXTERNAL_MEDIABOX_PATH/package/libtorrentrb/Config.in"
source "$BR2_EXTERNAL_MEDIABOX_PATH/package/python-pyxdg/Config.in"
source "$BR2_EXTERNAL_MEDIABOX_PATH/package/bluealsa/Config.in"
source "$BR2_EXTERNAL_MEDIABOX_PATH/package/raspi-gpio/Config.in"
source "$BR2_EXTERNAL_MEDIABOX_PATH/package/libwebsockets3/Config.in"
```

## sdk/external/package/avmount/Config.in
```kconfig
config BR2_PACKAGE_AVMOUNT
	bool "avmount"
	select BR2_PACKAGE_LIBCURL
	select BR2_PACKAGE_LIBUPNP
	help
	  UPnP media client implemented as a FUSE filesystem.

if BR2_PACKAGE_AVMOUNT
config BR2_PACKAGE_AVMOUNT_DEBUG
	bool "AVMount Debug Support"
	help
	  Enables runtime checks and debug output to log
	  file (or stderr).

endif
```

## sdk/external/package/bluealsa/Config.in
```kconfig
config BR2_PACKAGE_BLUEALSA
	bool "bluealsa"
	depends on BR2_TOOLCHAIN_HAS_THREADS_NPTL
	select BR2_PACKAGE_READLINE
	select BR2_PACKAGE_BLUEZ5_UTILS
	select BR2_PACKAGE_SBC
	select BR2_PACKAGE_ORTP
	select BR2_PACKAGE_LIBBSD
	help
	  ALSA <-> Bluetooth bridge.
```

## sdk/external/package/deluge/Config.in
```kconfig
config BR2_PACKAGE_DELUGE
	bool "deluge"
	select BR2_PACKAGE_PYTHON_CHARDET
	select BR2_PACKAGE_PYTHON_PYOPENSSL
	select BR2_PACKAGE_PYTHON_SETUPTOOLS
	select BR2_PACKAGE_PYTHON_TWISTED
	select BR2_PACKAGE_PYTHON_SERVICE_IDENTITY
	select BR2_PACKAGE_PYTHON_ATTRS
	select BR2_PACKAGE_PYTHON_PYXDG
	select BR2_PACKAGE_PYTHON_CFFI
	select BR2_PACKAGE_LIBTORRENTRB
	select BR2_PACKAGE_LIBTORRENTRB_PYTHON
	help
	  Command-line bittorrent client.

	  http://deluge-torrent.org
```

## sdk/external/package/libtorrent-rasterbar/Config.in
```kconfig
config BR2_PACKAGE_LIBTORRENT_RASTERBAR
	bool "libtorrent-rasterbar"
	depends on BR2_INSTALL_LIBSTDCPP
	depends on BR2_TOOLCHAIN_HAS_THREADS
	depends on BR2_TOOLCHAIN_HAS_SYNC_1 && BR2_TOOLCHAIN_HAS_SYNC_4
	select BR2_PACKAGE_ZLIB
	select BR2_PACKAGE_BOOST
	select BR2_PACKAGE_BOOST_SYSTEM
	select BR2_PACKAGE_BOOST_THREAD
	select BR2_PACKAGE_BOOST_FILESYSTEM
	select BR2_PACKAGE_BOOST_DATE_TIME
	help
	  C++ BitTorrent implementation focusing on efficiency and scalability

	  http://libtorrent.org

comment "libtorrent needs a toolchain w/ C++, threads"
	depends on BR2_TOOLCHAIN_HAS_SYNC_1 && BR2_TOOLCHAIN_HAS_SYNC_4
	depends on !BR2_INSTALL_LIBSTDCPP || !BR2_TOOLCHAIN_HAS_THREADS

if BR2_PACKAGE_LIBTORRENT_RASTERBAR

config BR2_PACKAGE_LIBTORRENT_RASTERBAR_PYTHON
	bool "libtorrent-rasterbar python bindings"
	select BR2_PACKAGE_BOOST_PYTHON
	help
	  Python bindings for libtorrent-rasterbar.
endif
```

## sdk/external/package/libtorrentpython/Config.in
```kconfig
config BR2_PACKAGE_LIBTORRENTPYTHON
	bool "libtorrent-rasterbar python bindings"
	depends on BR2_PACKAGE_LIBTORRENTRB
	select BR2_PACKAGE_BOOST_PYTHON
	help
	  Command-line bittorrent client.

	  http://deluge-torrent.org
```

## sdk/external/package/libtorrentrb/Config.in
```kconfig
config BR2_PACKAGE_LIBTORRENTRB
	bool "libtorrent-rasterbar"
	depends on BR2_INSTALL_LIBSTDCPP
	depends on BR2_TOOLCHAIN_HAS_THREADS
	depends on BR2_TOOLCHAIN_HAS_SYNC_1 && BR2_TOOLCHAIN_HAS_SYNC_4
	select BR2_PACKAGE_ZLIB
	select BR2_PACKAGE_BOOST
	select BR2_PACKAGE_BOOST_SYSTEM
	select BR2_PACKAGE_BOOST_THREAD
	select BR2_PACKAGE_BOOST_FILESYSTEM
	select BR2_PACKAGE_BOOST_DATE_TIME
	select BR2_PACKAGE_BOOST_CHRONO
	select BR2_PACKAGE_BOOST_RANDOM
	help
	  C++ BitTorrent implementation focusing on efficiency and scalability

	  http://libtorrent.org

comment "libtorrent needs a toolchain w/ C++, threads"
	depends on BR2_TOOLCHAIN_HAS_SYNC_1 && BR2_TOOLCHAIN_HAS_SYNC_4
	depends on !BR2_INSTALL_LIBSTDCPP || !BR2_TOOLCHAIN_HAS_THREADS
```

## sdk/external/package/mediabox/Config.in
```kconfig
config BR2_PACKAGE_MEDIABOX
	bool "MediaBox"
	depends on BR2_TOOLCHAIN_HAS_THREADS_NPTL
	depends on BR2_TOOLCHAIN_GCC_AT_LEAST_4_5
	depends on BR2_TOOLCHAIN_BUILDROOT_CXX
	select BR2_PACKAGE_CAIRO
	select BR2_PACKAGE_LIBCURL
	select BR2_PACKAGE_LIBUPNP
	select BR2_PACKAGE_ALSA_LIB
	select BR2_PACKAGE_PANGO
	select BR2_PACKAGE_FFMPEG
	select BR2_PACKAGE_FFMPEG_SWSCALE
	select BR2_PACKAGE_OPENSSL
	select BR2_PACKAGE_MEDIATOMB
	select BR2_PACKAGE_AVMOUNT
	select BR2_PACKAGE_DEJAVU
	select BR2_PACKAGE_LIBTORRENTRB
	help
	  A media player.

if BR2_PACKAGE_MEDIABOX

config BR2_PACKAGE_MEDIABOX_DEBUG
	bool "Build with debug information"
	help
	  Enables runtime checks and debug output to log
	  file (or stderr).

config BR2_PACKAGE_MEDIABOX_DIRECTFB
	bool "Enable the DirectFB video/input driver"
	select BR2_PACKAGE_DIRECTFB
	help
	  Enables the DirectFB video/input driver. You should only use this
	  driver if you only have a basic framebuffer or if you have accelerated
	  drivers for DirectFB.


config BR2_PACKAGE_MEDIABOX_LIBINPUT
	bool "Enable libinput support"
	select BR2_PACKAGE_LIBEVDEV	#libinput should do this
	select BR2_PACKAGE_LIBINPUT
	help
	  Enables the libinput input driver.


config BR2_PACKAGE_MEDIABOX_BLUETOOTH
	bool "Enable Bluetooth support"
	select BR2_PACKAGE_BLUEZ5_UTILS
	select BR2_PACKAGE_BLUEALSA
	depends on BR2_LINUX_KERNEL
	help
	  Enable Bluetooth support on MediaBox.

config BR2_PACKAGE_MEDIABOX_VC4
	bool "Enable the VC4 video driver"
	select BR2_PACKAGE_RPI_USERLAND
	help
	  Enable the VC4 video driver used by the Raspberry Pi.

config BR2_PACKAGE_MEDIABOX_LIBDRM
	bool "Enable the accelerated DRM driver (does not require an X server)"
	select BR2_PACKAGE_LIBDRM
	#select BR2_PACKAGE_XORG7
	#select BR2_PACKAGE_XSERVER_XORG_SERVER
	select BR2_PACKAGE_MESA3D
	help
	  Enable libdrm video driver.
	  Note that this driver does NOT depend on an X server.
	  The only reason that Xorg is selected is because I can't
	  get mesa3d to build libGL without selecting it. Apparently
	  a bug in buildroot.

config BR2_PACKAGE_MEDIABOX_X11
	bool "Enable the accelerated X11 driver"
	select BR2_PACKAGE_XORG7
	select BR2_PACKAGE_XSERVER_XORG_SERVER
	select BR2_PACKAGE_MESA3D
	help
	  Enable the X11 video driver.

config BR2_PACKAGE_MEDIABOX_DVD
	bool "Enable DVD playback support"
	select BR2_PACKAGE_LIBDVDNAV
	help
	  Enable DVD playback

config BR2_PACKAGE_MEDIABOX_REALTIME
	bool "Enable realtime scheduling"
	help
	  Enables EXPERIMENTAL realtime scheduling support.
	  This may lead to deadlocks!

config BR2_PACKAGE_MEDIABOX_WEBREMOTE
	bool "Enable web-based remote control"
	select BR2_PACKAGE_LIBWEBSOCKETS3
	help
	  Enables the web-based remote control.

endif # BR2_PACKAGE_MEDIABOX
```

## sdk/external/package/mediatomb/Config.in
```kconfig
config BR2_PACKAGE_MEDIATOMB
	bool "mediatomb"
	select BR2_PACKAGE_LIBCURL
	select BR2_PACKAGE_LIBUPNP
	select BR2_PACKAGE_OPENSSL
	select BR2_PACKAGE_ZLIB
	select BR2_PACKAGE_SQLITE
	select BR2_PACKAGE_FILE
	select BR2_PACKAGE_SPIDERMONKEY
	help
	  MediaTomb is an open source UPnP MediaServer.
```

## sdk/external/package/nspr/Config.in
```kconfig
config BR2_PACKAGE_NSPR
	bool "nspr"
	help
	  Netscape Portable Runtime

	  http://www.mozilla.org/projects/nspr/
```

## sdk/external/package/python-pyxdg/Config.in
```kconfig
config BR2_PACKAGE_PYTHON_PYXDG
	bool "python-pyxdg"
	select BR2_PACKAGE_PYTHON
	select BR2_PACKAGE_PYTHON_SETUPTOOLS
	help
	  A Python module to deal with freedesktop.org specifications.

	  https://freedesktop.org/wiki/Software/pyxdg
```

## sdk/external/package/raspi-gpio/Config.in
```kconfig
config BR2_PACKAGE_RASPI_GPIO
	bool "raspi-gpio"
	help
	  Dump the state of the BCM270x GPIOs
```

## sdk/external/package/spidermonkey/Config.in
```kconfig
config BR2_PACKAGE_SPIDERMONKEY
	bool "spidermonkey"
	select BR2_PACKAGE_PKGCONF
	select BR2_PACKAGE_NSPR
	help
	  Stand-alone JavaScript C library.

	  https://developer.mozilla.org/en-US/docs/Mozilla/Projects/SpiderMonkey
```
